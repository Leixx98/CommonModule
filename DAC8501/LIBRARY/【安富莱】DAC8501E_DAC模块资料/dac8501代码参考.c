编程非常简单，SPI是单向的，只需要： CS  MOSI  SCK 三根IO

C函数如下，请客户自己移植到不同的单片机系统。

 

/*
*********************************************************************************************************
*   函 数 名: DAC8501_SendData
*   功能说明: 向SPI总线发送24个bit数据。
*   形    参: _ch, 通道, 
*            _data : 数据
*   返 回 值: 无
*********************************************************************************************************
*/
void DAC8501_SendData(uint8_t _ch, uint16_t _dac)
{
    uint8_t i;
    uint32_t data;
 
    /*
        DAC8501.pdf page 12 有24bit定义
 
        DB24:18 = xxxxx 保留
        DB17： PD1
        DB16： PD0
 
        DB15：0  16位数据
 
        其中 PD1 PD0 决定4种工作模式
              0   0  ---> 正常工作模式
              0   1  ---> 输出接1K欧到GND
              1   0  ---> 输出100K欧到GND
              1   1  ---> 输出高阻
    */
 
    data = _dac;/* PD1 PD0 = 00 正常模式 */
 
    if (_ch == 0)
    {
        CS1_0();
    }
    else
    {
        CS2_0();
    }
 
    /*　DAC8501 SCLK时钟高达30M，因此可以不延迟 */
    for(i = 0; i < 24; i++)
    {
        if (data & 0x800000)
        {
            MOSI_1();
        }
        else
        {
            MOSI_0();
        }
        SCLK_1();
        data <<= 1;
        SCLK_0();
    }
    
    if (_ch == 0)
    {
        CS1_1();
    }
    else
    {
        CS2_1();
    }
}